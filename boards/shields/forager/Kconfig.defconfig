## boards/shields/forager/Kconfig.defconfig
```kconfig
if SHIELD_FORAGER_LEFT

config ZMK_KEYBOARD_NAME
    default "Forager"

config ZMK_SPLIT_ROLE_CENTRAL
    default y

config ZMK_STUDIO
    default y

endif

if SHIELD_FORAGER_LEFT || SHIELD_FORAGER_RIGHT || SHIELD_FORAGER_DONGLE

config ZMK_SPLIT
    default y

config ZMK_BLE
    default y
    
# Set this to the number of peripherals your dongle will have.
# For a unibody, this would be 1. If you have left and right halves, set it to 2, etc.
config ZMK_SPLIT_BLE_CENTRAL_PERIPHERALS
    default 1

# Set this to ZMK_SPLIT_BLE_CENTRAL_PERIPHERALS + your desired number of BT profiles (default is 5)
config BT_MAX_CONN
    default 6

# Set this to the same number as BT_MAX_CONN
config BT_MAX_PAIRED
    default 6

config PROSPECTOR_FIXED_BRIGHTNESS
    int "Fixed brightness level for Prospector"
    depends on !PROSPECTOR_USE_AMBIENT_LIGHT_SENSOR
    default 20
    help
      Sets a fixed brightness level for the Prospector keyboard when ambient light sensor is disabled.
endif
```
